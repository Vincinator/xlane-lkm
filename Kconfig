## Kconfig
```kconfig
#
# Sassy subsystem configuration
#

menuconfig ASGARD
	bool "Enable ASGARD"
	default y
	help
	  This enables the network submodule ASGARD

config ASGARD_FOLLOWER_TEST
        bool "Follower test"
        depends on ASGARD && KUNIT

config ASGARD_NET_TEST
        bool "Net Helper test"
        depends on ASGARD && KUNIT
```
